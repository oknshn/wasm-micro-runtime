## CMakeLists.txt
```
# Copyright (C) 2019 Intel Corporation.  All rights reserved.
# SPDX-License-Identifier: Apache-2.0 WITH LLVM-exception

cmake_minimum_required(VERSION 3.8.2)

find_package(Zephyr REQUIRED HINTS $ENV{ZEPHYR_BASE})
project(wamr)

enable_language (ASM)

set (WAMR_BUILD_PLATFORM "zephyr")

# Build as X86_32 by default, change to "AARCH64[sub]", "ARM[sub]", "THUMB[sub]", "MIPS" or "XTENSA"
# if we want to support arm, thumb, mips or xtensa
if (NOT DEFINED WAMR_BUILD_TARGET)
  set (WAMR_BUILD_TARGET "X86_32")
endif ()

if (NOT DEFINED WAMR_BUILD_INTERP)
  # Enable Interpreter by default
  set (WAMR_BUILD_INTERP 1)
endif ()

if (NOT DEFINED WAMR_BUILD_AOT)
  # Enable AOT by default.
  set (WAMR_BUILD_AOT 1)
endif ()

if (NOT DEFINED WAMR_BUILD_LIBC_BUILTIN)
  # Enable libc builtin support by default
  set (WAMR_BUILD_LIBC_BUILTIN 1)
endif ()

if (NOT DEFINED WAMR_BUILD_LIBC_WASI)
  # Disable libc wasi support by default
  set (WAMR_BUILD_LIBC_WASI 0)
endif ()

if (WAMR_BUILD_TARGET STREQUAL "RISCV64_LP64" OR WAMR_BUILD_TARGET STREQUAL "RISCV32_ILP32")
  set (WAMR_BUILD_FAST_INTERP 1)
endif ()

# Override the global heap usage
if (NOT DEFINED WAMR_BUILD_GLOBAL_HEAP_POOL)
  set (WAMR_BUILD_GLOBAL_HEAP_POOL 1)
endif ()

# Override the global heap size for small devices
if (NOT DEFINED WAMR_BUILD_GLOBAL_HEAP_SIZE)
  set (WAMR_BUILD_GLOBAL_HEAP_SIZE 131072) # 128 KB
endif ()

set (WAMR_ROOT_DIR ${CMAKE_CURRENT_SOURCE_DIR}/../../../..)

include (${WAMR_ROOT_DIR}/build-scripts/runtime_lib.cmake)

target_sources(app PRIVATE
               ${WAMR_RUNTIME_LIB_SOURCE}
               src/main.c
               src/thesis_native_bench.c)
```

## prj.conf
```kconfig
# Copyright (C) 2019 Intel Corporation.  All rights reserved.
# SPDX-License-Identifier: Apache-2.0 WITH LLVM-exception

CONFIG_STACK_SENTINEL=y
CONFIG_PRINTK=y
#CONFIG_LOG_BUFFER_SIZE=32768

# =============================================================================
# Hardware FPU (critical for float32 performance on Cortex-M4F!)
# =============================================================================
CONFIG_FPU=y

# =============================================================================
# CMSIS-DSP Configuration (ARM Cortex-M)
# =============================================================================
CONFIG_CMSIS_DSP=y
CONFIG_CMSIS_DSP_SUPPORT=y
CONFIG_CMSIS_DSP_BASICMATH=y
CONFIG_CMSIS_DSP_MATRIX=y
CONFIG_CMSIS_DSP_STATISTICS=y
CONFIG_CMSIS_DSP_FASTMATH=y

# Enable loop unrolling optimization (4x unroll for better pipelining)
CONFIG_CMSIS_DSP_LOOPUNROLL=y

# Enable CMSIS-NN so Cortex-M targets (e.g. MAX32690)
# can use convolution and softmax NN kernels.
CONFIG_CMSIS_NN=y
CONFIG_CMSIS_NN_CONVOLUTION=y
CONFIG_CMSIS_NN_SOFTMAX=y
CONFIG_CMSIS_NN_NNSUPPORT=y
```

## src/main.c
```c
/*
 * Copyright (C) 2019 Intel Corporation.  All rights reserved.
 * SPDX-License-Identifier: Apache-2.0 WITH LLVM-exception
 */

#include <stdlib.h>
#include <string.h>
#include "bh_platform.h"
#include "bh_assert.h"
#include "bh_log.h"
#include "wasm_export.h"

#include "thesis_native_bench.h"
#if defined(BUILD_TARGET_RISCV64_LP64) || defined(BUILD_TARGET_RISCV32_ILP32)
#include "test_wasm_riscv64.h"
#else
#include "test_wasm.h"
#endif /* end of BUILD_TARGET_RISCV64_LP64 || BUILD_TARGET_RISCV32_ILP32 */

#if defined(BUILD_TARGET_RISCV64_LP64) || defined(BUILD_TARGET_RISCV32_ILP32)
#define CONFIG_GLOBAL_HEAP_BUF_SIZE WASM_GLOBAL_HEAP_SIZE
#define CONFIG_APP_STACK_SIZE 8192
#define CONFIG_APP_HEAP_SIZE 8192
#else /* else of BUILD_TARGET_RISCV64_LP64 || BUILD_TARGET_RISCV32_ILP32 */
#define CONFIG_GLOBAL_HEAP_BUF_SIZE WASM_GLOBAL_HEAP_SIZE
#define CONFIG_APP_STACK_SIZE 8192
#define CONFIG_APP_HEAP_SIZE 8192
#endif /* end of BUILD_TARGET_RISCV64_LP64 || BUILD_TARGET_RISCV32_ILP32 */

/* Increase native runtime thread stack to handle large benchmark locals */
#define CONFIG_MAIN_THREAD_STACK_SIZE 16384

static int app_argc;
static char **app_argv;

/**
 * Find the unique main function from a WASM module instance
 * and execute that function.
 *
 * @param module_inst the WASM module instance
 * @param argc the number of arguments
 * @param argv the arguments array
 *
 * @return true if the main function is called, false otherwise.
 */
bool
wasm_application_execute_main(wasm_module_inst_t module_inst, int argc,
                              char *argv[]);

static void *
app_instance_main(wasm_module_inst_t module_inst)
{
    const char *exception;
    wasm_function_inst_t func;
    wasm_exec_env_t exec_env;
    unsigned argv[2] = { 0 };

    if (wasm_runtime_lookup_function(module_inst, "main")
        || wasm_runtime_lookup_function(module_inst, "__main_argc_argv")) {
        LOG_VERBOSE("Calling main function\n");
        wasm_application_execute_main(module_inst, app_argc, app_argv);
    }
    else if ((func = wasm_runtime_lookup_function(module_inst, "app_main"))) {
        exec_env =
            wasm_runtime_create_exec_env(module_inst, CONFIG_APP_HEAP_SIZE);
        if (!exec_env) {
            os_printf("Create exec env failed\n");
            return NULL;
        }

        LOG_VERBOSE("Calling app_main function\n");
        wasm_runtime_call_wasm(exec_env, func, 0, argv);

        if (!wasm_runtime_get_exception(module_inst)) {
            os_printf("result: 0x%x\n", argv[0]);
        }

        wasm_runtime_destroy_exec_env(exec_env);
    }
    else {
        os_printf("Failed to lookup function main or app_main to call\n");
        return NULL;
    }

    if ((exception = wasm_runtime_get_exception(module_inst)))
        os_printf("%s\n", exception);

    return NULL;
}

#if WASM_ENABLE_GLOBAL_HEAP_POOL != 0
static char global_heap_buf[CONFIG_GLOBAL_HEAP_BUF_SIZE] = { 0 };
#endif

void
iwasm_main(void *arg1, void *arg2, void *arg3)
{
    int start, end;

    /* Run native (non-WASM) thesis benchmarks first, using the same
     * kernels and inputs but without going through the WASM
     * interpreter. This provides a direct Zephyr baseline that can
     * be compared against the WAMR-based results.
     */
    thesis_native_bench_run();

    start = k_uptime_get_32();
    uint8 *wasm_file_buf = NULL;
    uint32 wasm_file_size;
    wasm_module_t wasm_module = NULL;
    wasm_module_inst_t wasm_module_inst = NULL;
    RuntimeInitArgs init_args;
    char error_buf[128];
#if WASM_ENABLE_LOG != 0
    int log_verbose_level = 2;
#endif

    (void)arg1;
    (void)arg2;
    (void)arg3;

    memset(&init_args, 0, sizeof(RuntimeInitArgs));

#if WASM_ENABLE_GLOBAL_HEAP_POOL != 0
    init_args.mem_alloc_type = Alloc_With_Pool;
    init_args.mem_alloc_option.pool.heap_buf = global_heap_buf;
    init_args.mem_alloc_option.pool.heap_size = sizeof(global_heap_buf);
#elif (defined(CONFIG_COMMON_LIBC_MALLOC)            \
       && CONFIG_COMMON_LIBC_MALLOC_ARENA_SIZE != 0) \
    || defined(CONFIG_NEWLIB_LIBC)
    init_args.mem_alloc_type = Alloc_With_System_Allocator;
#else
#error "memory allocation scheme is not defined."
#endif

    /* initialize runtime environment */
    if (!wasm_runtime_full_init(&init_args)) {
        printf("Init runtime environment failed.\n");
        return;
    }

#if WASM_ENABLE_LOG != 0
    bh_log_set_verbose_level(log_verbose_level);
#endif

    /* load WASM byte buffer from byte buffer of include file */
    wasm_file_buf = (uint8 *)wasm_test_file;
    wasm_file_size = sizeof(wasm_test_file);

    /* load WASM module */
    if (!(wasm_module = wasm_runtime_load(wasm_file_buf, wasm_file_size,
                                          error_buf, sizeof(error_buf)))) {
        printf("%s\n", error_buf);
        goto fail1;
    }

    /* instantiate the module */
    if (!(wasm_module_inst = wasm_runtime_instantiate(
              wasm_module, CONFIG_APP_STACK_SIZE, CONFIG_APP_HEAP_SIZE,
              error_buf, sizeof(error_buf)))) {
        printf("%s\n", error_buf);
        goto fail2;
    }

    /* invoke the main function */
    app_instance_main(wasm_module_inst);

    /* destroy the module instance */
    wasm_runtime_deinstantiate(wasm_module_inst);

fail2:
    /* unload the module */
    wasm_runtime_unload(wasm_module);

fail1:
    /* destroy runtime environment */
    wasm_runtime_destroy();

    end = k_uptime_get_32();

    printf("elapsed: %d\n", (end - start));
}

#define MAIN_THREAD_STACK_SIZE (CONFIG_MAIN_THREAD_STACK_SIZE)
#define MAIN_THREAD_PRIORITY 5

K_THREAD_STACK_DEFINE(iwasm_main_thread_stack, MAIN_THREAD_STACK_SIZE);
static struct k_thread iwasm_main_thread;

bool
iwasm_init(void)
{
    k_tid_t tid = k_thread_create(
        &iwasm_main_thread, iwasm_main_thread_stack, MAIN_THREAD_STACK_SIZE,
        iwasm_main, NULL, NULL, NULL, MAIN_THREAD_PRIORITY, 0, K_NO_WAIT);
    return tid ? true : false;
}

#if KERNEL_VERSION_NUMBER < 0x030400 /* version 3.4.0 */
void
main(void)
{
    iwasm_init();
}
#else
int
main(void)
{
    iwasm_init();
    return 0;
}
#endif
```

## src/thesis_native_bench.c
```c
#include <zephyr/kernel.h>
#include <zephyr/sys/printk.h>
#include <stdint.h>
#include <math.h>
#include <string.h>

/* Reuse the same synthetic input seeds and kernel API declarations
 * as the thesis WASM apps.
 */
#include "../../../../../product-mini/app-samples/thesis-example-cmdis-dsp-basicmath/thesis-lib.h"

/* Use the same cycle counter helper as lib_thesis_wrapper.c so that
 * native and WASM measurements are directly comparable.
 */
#include "../../../../../core/iwasm/libraries/lib-thesis/thesis_timer.h"

/* We call directly into the native wrappers used by WAMR. They don't
 * use the exec_env parameter for these kernels, so we pass NULL.
 */
#include "wasm_export.h"

extern void vec_abs_wrapper(wasm_exec_env_t exec_env, int *input, int len);
extern void vec_add_wrapper(wasm_exec_env_t exec_env, int *a, int len_a,
			      int *b, int len_b);
extern void vec_mul_wrapper(wasm_exec_env_t exec_env, int *a, int len_a,
			      int *b, int len_b);
extern void dot_product_wrapper(wasm_exec_env_t exec_env, int *a, int len_a,
				      int *b, int len_b);
extern void mat_mul_wrapper(wasm_exec_env_t exec_env, int *A, int m, int k,
			    int *B, int k2, int n, int *C);
extern void conv2d_small_wrapper(wasm_exec_env_t exec_env, int *input,
					 int in_h, int in_w, int *kernel,
					 int k_h, int k_w, int *output,
					 int *scratch_buf);
extern void softmax_wrapper(wasm_exec_env_t exec_env, int *input, int len,
				    int *output);
extern void rmsnorm_wrapper(wasm_exec_env_t exec_env, int *input, int len,
				    int *output);

typedef struct {
	const char *name;
	int vec_len;      /* length for vec_* */
	int mat_m, mat_k, mat_n;
	int img_h, img_w, k_h, k_w;
} bench_case_t;

/* Maximum length used across all benchmarks (elements).
 * Match the WASM apps: up to 1024 elements shared between
 * vector and matrix data (matrices use sqrt(N) x sqrt(N)).
 */
#define MAX_BENCH_LEN 1024
#define ITERATIONS 100

static float input1_buf[MAX_BENCH_LEN];
static float input2_buf[MAX_BENCH_LEN];
static float scratch_buf[MAX_BENCH_LEN];
static float ref_buf[MAX_BENCH_LEN];
static volatile float ref_sink_native;

/* Q15 buffers for vec_add, vec_mul, dot_product, mat_mul on THUMB/RISCV. */
static int16_t input1_q15[MAX_BENCH_LEN];
static int16_t input2_q15[MAX_BENCH_LEN];
static int16_t scratch_q15[MAX_BENCH_LEN];

/* Int8 buffers for conv2d and softmax (used by native int8 kernels). */
static int8_t conv_input_s8[MAX_BENCH_LEN];
static int8_t conv_kernel_s8[MAX_BENCH_LEN];
static int8_t conv_out_s8[MAX_BENCH_LEN];
static int8_t softmax_in_s8[MAX_BENCH_LEN];
static int8_t softmax_out_s8[MAX_BENCH_LEN];
static int8_t conv_ref_s8[MAX_BENCH_LEN];
static int8_t softmax_ref_s8[MAX_BENCH_LEN];
static uint8_t conv_scratch_buf[48];

static int8_t
quantize_f32_to_s8(float v, float scale)
{
	float scaled = v * scale;
	int q = (int)(scaled >= 0.0f ? scaled + 0.5f : scaled - 0.5f);
	if (q > 127)
		q = 127;
	else if (q < -128)
		q = -128;
	return (int8_t)q;
}

static int16_t
quantize_f32_to_q15(float v, float scale)
{
	float scaled = v * scale;
	int q = (int)(scaled >= 0.0f ? scaled + 0.5f : scaled - 0.5f);
	if (q > 32767)
		q = 32767;
	else if (q < -32768)
		q = -32768;
	return (int16_t)q;
}

static void
ref_vec_abs(float *data, int len)
{
	for (int i = 0; i < len; i++) {
		float v = data[i] < 0.0f ? -data[i] : data[i];
		data[i] = v;
		ref_sink_native += v;
	}
}

static void
compare_vec_f32(const char *name, const float *exp, const float *got,
		      int len, float tol)
{
	int mismatches = 0;
	float max_diff = 0.0f;

	for (int i = 0; i < len; i++) {
		float d = exp[i] - got[i];
		if (d < 0.0f)
			d = -d;
		if (d > tol) {
			mismatches++;
			if (d > max_diff)
				max_diff = d;
		}
	}

	if (mismatches == 0) {
		return 0;
		//printk("[%s][validate] PASS (len=%d)\n", name, len);
	} else {
		/* Scale max_diff to micro-units to avoid printing floats. */
		int max_diff_micro = (int)(max_diff * 1000000.0f);
		printk("[%s][validate] FAIL: mismatches=%d, max_diff_x1e-6=%d\n",
		       name, mismatches, max_diff_micro);
	}
}

static void
compare_vec_s8(const char *name, const int8_t *exp, const int8_t *got,
	       int len, int tol)
{
	int mismatches = 0;
	int max_diff = 0;

	for (int i = 0; i < len; i++) {
		int d = (int)exp[i] - (int)got[i];
		if (d < 0)
			d = -d;
		if (d > tol) {
			mismatches++;
			if (d > max_diff)
				max_diff = d;
		}
	}

	if (mismatches == 0) {
		return;
	}

	printk("[%s][validate_s8] FAIL: mismatches=%d, max_abs_diff=%d (tol=%d)\n",
	       name, mismatches, max_diff, tol);
}

static void
ref_vec_add(float *a, int len_a, const float *b, int len_b)
{
	int n = len_a;
	(void)len_b;
	for (int i = 0; i < n; i++) {
		float v = a[i] + b[i];
		a[i] = v;
		ref_sink_native += v;
	}
}

static void
ref_vec_mul(float *a, int len_a, const float *b, int len_b)
{
	int n = len_a;
	(void)len_b;
	for (int i = 0; i < n; i++) {
		float v = a[i] * b[i];
		a[i] = v;
		ref_sink_native += v;
	}
}

static float
ref_dot_product(float *a, int len_a, const float *b, int len_b)
{
	int n = len_a;
	(void)len_b;
	float acc = 0.0f;
	for (int i = 0; i < n; i++) {
		acc += a[i] * b[i];
	}
	a[0] = acc;
	return acc;
}

static void
ref_mat_mul(const float *A, const float *B, float *C,
	    int m, int k, int n)
{
	for (int i = 0; i < m; i++) {
		for (int j = 0; j < n; j++) {
			float sum = 0.0f;
			for (int kk = 0; kk < k; kk++) {
				sum += A[i * k + kk] * B[kk * n + j];
			}
			C[i * n + j] = sum;
			ref_sink_native += sum;
		}
	}
}

static void
ref_rmsnorm(const float *x, float *y, int len)
{
	const float eps = 1e-5f;
	float sum_sq = 0.0f;

	for (int i = 0; i < len; i++) {
		float v = x[i];
		sum_sq += v * v;
	}

	float mean_sq = sum_sq / (float)len;
	float denom = sqrtf(mean_sq + eps);
	if (denom <= 0.0f)
		denom = 1.0f;
	float inv_denom = 1.0f / denom;

	for (int i = 0; i < len; i++) {
		float v = x[i] * inv_denom;
		y[i] = v;
		ref_sink_native += v;
	}
}

static void
ref_conv2d_s8(const int8_t *img, int in_h, int in_w,
	      const int8_t *ker, int k_h, int k_w,
	      int8_t *out)
{
	int out_h = in_h - k_h + 1;
	int out_w = in_w - k_w + 1;

	for (int i = 0; i < out_h; i++) {
		for (int j = 0; j < out_w; j++) {
			int32_t acc = 0;
			for (int kh = 0; kh < k_h; kh++) {
				for (int kw = 0; kw < k_w; kw++) {
					int ih = i + kh;
					int iw = j + kw;
					acc += (int32_t)img[ih * in_w + iw]
					       * (int32_t)ker[kh * k_w + kw];
				}
			}
			if (acc > 127)
				acc = 127;
			else if (acc < -128)
				acc = -128;
			out[i * out_w + j] = (int8_t)acc;
		}
	}
}

static void
ref_softmax_s8(const int8_t *input, int len, int8_t *output)
{
	float max_val = (float)input[0];
	for (int i = 1; i < len; i++) {
		float v = (float)input[i];
		if (v > max_val)
			max_val = v;
	}

	float sum = 0.0f;
	float tmp[MAX_BENCH_LEN];

	for (int i = 0; i < len; i++) {
		float e = expf((float)input[i] - max_val);
		tmp[i] = e;
		sum += e;
	}

	if (sum <= 0.0f) {
		for (int i = 0; i < len; i++)
			output[i] = 0;
		return;
	}

	float inv_sum = 1.0f / sum;
	for (int i = 0; i < len; i++) {
		float p = tmp[i] * inv_sum;
		float q = p * 127.0f;
		int qi = (int)(q >= 0.0f ? q + 0.5f : q - 0.5f);
		if (qi > 127)
			qi = 127;
		else if (qi < -128)
			qi = -128;
		output[i] = (int8_t)qi;
	}
}

static void
init_buffers(int len)
{
	int seed_len = (int)(sizeof(f32_input1) / sizeof(f32_input1[0]));
	const float *seed1 = (const float *)f32_input1;
	const float *seed2 = (const float *)f32_input2;

	for (int i = 0; i < len; i++) {
		float v1 = seed1[i % seed_len];
		float v2 = seed2[i % seed_len];

		input1_buf[i] = v1;
		input2_buf[i] = v2;

		/* Pre-quantize Q15 inputs for vec_add, vec_mul, dot_product, mat_mul
		 * on THUMB/RISCV platforms.
		 */
		input1_q15[i] = quantize_f32_to_q15(v1, 16384.0f);
		input2_q15[i] = quantize_f32_to_q15(v2, 16384.0f);

		/* Pre-quantize int8 inputs for conv2d and softmax so that
		 * the native int8 kernels can be called directly without
		 * any per-call quantization overhead.
		 */
		conv_input_s8[i] = quantize_f32_to_s8(v1, 32.0f);
		conv_kernel_s8[i] = quantize_f32_to_s8(v2, 32.0f);
		softmax_in_s8[i] = quantize_f32_to_s8(v1, 16.0f);
	}
}

/* Same benchmark shapes as the WASM apps.
 * Vector kernels use N in {4,16,64,256,1024} as their length.
 * Matrix kernels use square matrices with total size equal to
 * the vector size: 4->2x2, 16->4x4, 64->8x8, 256->16x16, 1024->32x32.
 */
static const bench_case_t bench_cases[] = {
	/*  name,  vec_len (vector N),  mat(m,k,n),     img(H,W,kH,kW) */
	{ "N=4",       4,    2,   2,   2,      2,   2, 1, 1 },
	{ "N=16",     16,    4,   4,   4,      4,   4, 1, 1 },
	{ "N=64",     64,    8,   8,   8,      8,   8, 1, 1 },
	{ "N=256",   256,   16,  16,  16,     16,  16, 1, 1 },
	{ "N=1024", 1024,   32,  32,  32,     32,  32, 1, 1 },
};

void
thesis_native_bench_run(void)
{
	size_t num_cases = sizeof(bench_cases) / sizeof(bench_cases[0]);

	for (size_t ci = 0; ci < num_cases; ci++) {
		const bench_case_t *c = &bench_cases[ci];
		int needed = c->vec_len;

		if (c->mat_m * c->mat_k > needed)
			needed = c->mat_m * c->mat_k;
		if (c->mat_k * c->mat_n > needed)
			needed = c->mat_k * c->mat_n;
		if (c->img_h * c->img_w > needed)
			needed = c->img_h * c->img_w;
		if (c->k_h * c->k_w > needed)
			needed = c->k_h * c->k_w;

		init_buffers(needed);

		printk("\n=== Benchmark case (native): %s ===\n", c->name);

		mem_time_t start, end;

		/* vec_abs timing (Q15 on THUMB/RISCV, float32 on AARCH64). */
#if defined(BUILD_TARGET_THUMB) || defined(BUILD_TARGET_RISCV32_ILP32)
		start = get_count();
		for (int i = 0; i < ITERATIONS; i++) {
			vec_abs_wrapper(NULL, (int *)input1_q15, c->vec_len);
		}
		end = get_count();
		if (end < start)
			end = start;
		printk("[vec_abs][native] Elapsed ticks: %u\n",
		       (unsigned int)((end - start) / ITERATIONS));
#else
		start = get_count();
		for (int i = 0; i < ITERATIONS; i++) {
			vec_abs_wrapper(NULL, (int *)input1_buf, c->vec_len);
		}
		end = get_count();
		if (end < start)
			end = start;
		printk("[vec_abs][native] Elapsed ticks: %u\n",
		       (unsigned int)((end - start) / ITERATIONS));
#endif

		/* vec_add timing (Q15 on THUMB/RISCV, float32 on AARCH64). */
#if defined(BUILD_TARGET_THUMB) || defined(BUILD_TARGET_RISCV32_ILP32)
		start = get_count();
		for (int i = 0; i < ITERATIONS; i++) {
			vec_add_wrapper(NULL, (int *)input1_q15, c->vec_len,
					(int *)input2_q15, c->vec_len);
		}
		end = get_count();
		if (end < start)
			end = start;
		printk("[vec_add][native] Elapsed ticks: %u\n",
		       (unsigned int)((end - start) / ITERATIONS));
#else
		start = get_count();
		for (int i = 0; i < ITERATIONS; i++) {
			vec_add_wrapper(NULL, (int *)input1_buf, c->vec_len,
					(int *)input2_buf, c->vec_len);
		}
		end = get_count();
		if (end < start)
			end = start;
		printk("[vec_add][native] Elapsed ticks: %u\n",
		       (unsigned int)((end - start) / ITERATIONS));
#endif

		/* vec_mul timing (Q15 on THUMB/RISCV, float32 on AARCH64). */
#if defined(BUILD_TARGET_THUMB) || defined(BUILD_TARGET_RISCV32_ILP32)
		start = get_count();
		for (int i = 0; i < ITERATIONS; i++) {
			vec_mul_wrapper(NULL, (int *)input1_q15, c->vec_len,
					(int *)input2_q15, c->vec_len);
		}
		end = get_count();
		if (end < start)
			end = start;
		printk("[vec_mul][native] Elapsed ticks: %u\n",
		       (unsigned int)((end - start) / ITERATIONS));
#else
		start = get_count();
		for (int i = 0; i < ITERATIONS; i++) {
			vec_mul_wrapper(NULL, (int *)input1_buf, c->vec_len,
					(int *)input2_buf, c->vec_len);
		}
		end = get_count();
		if (end < start)
			end = start;
		printk("[vec_mul][native] Elapsed ticks: %u\n",
		       (unsigned int)((end - start) / ITERATIONS));
#endif

		/* dot_product timing (Q15 on THUMB/RISCV, float32 on AARCH64). */
#if defined(BUILD_TARGET_THUMB) || defined(BUILD_TARGET_RISCV32_ILP32)
		start = get_count();
		for (int i = 0; i < ITERATIONS; i++) {
			dot_product_wrapper(NULL, (int *)input1_q15, c->vec_len,
					 (int *)input2_q15, c->vec_len);
		}
		end = get_count();
		if (end < start)
			end = start;
		printk("[dot_product][native] Elapsed ticks: %u\n",
		       (unsigned int)((end - start) / ITERATIONS));
#else
		start = get_count();
		for (int i = 0; i < ITERATIONS; i++) {
			dot_product_wrapper(NULL, (int *)input1_buf, c->vec_len,
					 (int *)input2_buf, c->vec_len);
		}
		end = get_count();
		if (end < start)
			end = start;
		printk("[dot_product][native] Elapsed ticks: %u\n",
		       (unsigned int)((end - start) / ITERATIONS));
#endif

		/* mat_mul timing (Q15 on THUMB/RISCV, float32 on AARCH64). */
#if defined(BUILD_TARGET_THUMB) || defined(BUILD_TARGET_RISCV32_ILP32)
		start = get_count();
		for (int i = 0; i < ITERATIONS; i++) {
			mat_mul_wrapper(NULL, (int *)input1_q15, c->mat_m, c->mat_k,
			       (int *)input2_q15, c->mat_k, c->mat_n,
			       (int *)scratch_q15);
		}
		end = get_count();
		if (end < start)
			end = start;
		printk("[mat_mul][native] Elapsed ticks: %u (m=%d,k=%d,n=%d)\n",
		       (unsigned int)((end - start) / ITERATIONS),
		       c->mat_m, c->mat_k, c->mat_n);
#else
		start = get_count();
		for (int i = 0; i < ITERATIONS; i++) {
			mat_mul_wrapper(NULL, (int *)input1_buf, c->mat_m, c->mat_k,
			       (int *)input2_buf, c->mat_k, c->mat_n,
			       (int *)scratch_buf);
		}
		end = get_count();
		if (end < start)
			end = start;
		printk("[mat_mul][native] Elapsed ticks: %u (m=%d,k=%d,n=%d)\n",
		       (unsigned int)((end - start) / ITERATIONS),
		       c->mat_m, c->mat_k, c->mat_n);
#endif

		/* rmsnorm timing - uses Q15 on THUMB/RISCV, float32 on AARCH64. */
		if (c->vec_len > 0) {
#if defined(BUILD_TARGET_THUMB) || defined(BUILD_TARGET_RISCV32_ILP32)
			start = get_count();
			for (int i = 0; i < ITERATIONS; i++) {
				rmsnorm_wrapper(NULL, (int *)input1_q15, c->vec_len,
				       (int *)scratch_q15);
			}
			end = get_count();
#else
			start = get_count();
			for (int i = 0; i < ITERATIONS; i++) {
				rmsnorm_wrapper(NULL, (int *)input1_buf, c->vec_len,
				       (int *)scratch_buf);
			}
			end = get_count();
#endif
			if (end < start)
				end = start;
			printk("[rmsnorm][native] Elapsed ticks: %u (len=%d)\n",
			       (unsigned int)((end - start) / ITERATIONS), c->vec_len);
		}

		/* conv2d_small validation and timing using pre-quantized int8 inputs. */
		{
			int out_h = c->img_h - c->k_h + 1;
			int out_w = c->img_w - c->k_w + 1;

			if (out_h > 0 && out_w > 0) {
				int out_len = out_h * out_w;

				/* Reference int8 conv2d. */
				ref_conv2d_s8(conv_input_s8, c->img_h, c->img_w,
				      conv_kernel_s8, c->k_h, c->k_w,
				      conv_ref_s8);

				/* Wrapper conv2d. */
				conv2d_small_wrapper(NULL, (int *)conv_input_s8,
						 c->img_h, c->img_w,
						 (int *)conv_kernel_s8,
						 c->k_h, c->k_w,
						 (int *)conv_out_s8,
						 (int *)conv_scratch_buf);

				compare_vec_s8("conv2d_small", conv_ref_s8, conv_out_s8,
				       out_len, 128);

				/* Timing. */
				start = get_count();
				for (int i = 0; i < ITERATIONS; i++) {
					conv2d_small_wrapper(NULL, (int *)conv_input_s8,
							 c->img_h, c->img_w,
							 (int *)conv_kernel_s8,
							 c->k_h, c->k_w,
							 (int *)conv_out_s8,
							 (int *)conv_scratch_buf);
				}
				end = get_count();
				if (end < start)
					end = start;
				printk("[conv2d_small][native] Elapsed ticks: %u (H=%d,W=%d,kH=%d,kW=%d)\n",
				       (unsigned int)((end - start) / ITERATIONS),
				       c->img_h, c->img_w, c->k_h, c->k_w);
			}
		}

		/* softmax validation and timing using pre-quantized int8 inputs. */
		if (c->vec_len > 0) {
			/* Reference int8 softmax. */
			ref_softmax_s8(softmax_in_s8, c->vec_len, softmax_ref_s8);

			/* Wrapper softmax. */
			softmax_wrapper(NULL, (int *)softmax_in_s8,
				       c->vec_len,
				       (int *)softmax_out_s8);

			compare_vec_s8("softmax", softmax_ref_s8, softmax_out_s8,
			       c->vec_len, 255);

			start = get_count();
			for (int i = 0; i < ITERATIONS; i++) {
				softmax_wrapper(NULL, (int *)softmax_in_s8,
					       c->vec_len,
					       (int *)softmax_out_s8);
			}
			end = get_count();
			if (end < start)
				end = start;
			printk("[softmax][native] Elapsed ticks: %u (len=%d)\n",
			       (unsigned int)((end - start) / ITERATIONS),
			       c->vec_len);
		}

	}
}
```

## src/thesis_native_bench.h
```c
/* Native (non-WASM) benchmark harness for thesis kernels.
 *
 * This runs directly on Zephyr and calls the same native
 * implementations that lib_thesis_wrapper.c uses, but without
 * going through the WAMR interpreter. It uses the same synthetic
 * inputs and problem sizes as the WASM apps.
 */

#ifndef THESIS_NATIVE_BENCH_H
#define THESIS_NATIVE_BENCH_H

void thesis_native_bench_run(void);

#endif /* THESIS_NATIVE_BENCH_H */
```
