## product-mini/platforms/zephyr/thesis-example-fw/qemu_rv64_nmsis_opt/Kconfig/arch/Kconfig
```kconfig
# Load Zephyr Arch Kconfig descriptions.
osource "/home/vboxuser/zephyrproject/zephyr/arch/rx/Kconfig"
osource "/home/vboxuser/zephyrproject/zephyr/arch/x86/Kconfig"
osource "/home/vboxuser/zephyrproject/zephyr/arch/xtensa/Kconfig"
osource "/home/vboxuser/zephyrproject/zephyr/arch/sparc/Kconfig"
osource "/home/vboxuser/zephyrproject/zephyr/arch/riscv/Kconfig"
osource "/home/vboxuser/zephyrproject/zephyr/arch/posix/Kconfig"
osource "/home/vboxuser/zephyrproject/zephyr/arch/mips/Kconfig"
osource "/home/vboxuser/zephyrproject/zephyr/arch/arm64/Kconfig"
osource "/home/vboxuser/zephyrproject/zephyr/arch/arm/Kconfig"
osource "/home/vboxuser/zephyrproject/zephyr/arch/arc/Kconfig"
```

## product-mini/platforms/zephyr/thesis-example-fw/qemu_rv64_nmsis_opt/Kconfig/boards/Kconfig
```kconfig
# Load Zephyr board Kconfig descriptions.
osource "/home/vboxuser/zephyrproject/zephyr/boards/qemu/riscv64/Kconfig"
```

## product-mini/platforms/zephyr/thesis-example-fw/qemu_rv64_nmsis_opt/Kconfig/boards/Kconfig.defconfig
```kconfig
# Load Zephyr board defconfig descriptions.
osource "/home/vboxuser/zephyrproject/zephyr/boards/qemu/riscv64/Kconfig.defconfig"
```

## product-mini/platforms/zephyr/thesis-example-fw/qemu_rv64_nmsis_opt/Kconfig/boards/Kconfig.sysbuild
```kconfig
# Load Sysbuild board Kconfig descriptions.
osource "/home/vboxuser/zephyrproject/zephyr/boards/qemu/riscv64/Kconfig.sysbuild"
```
